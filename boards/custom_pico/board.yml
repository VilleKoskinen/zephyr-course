## boards/custom_pico/board.yml
```yaml
board:
  name: custom_pico
  full_name: Custom Raspberry Pi Pico
  vendor: raspberrypi
  socs:
  - name: rp2040
```

## boards/custom_pico_scratch/board.yml
```yaml
board:
  name: custom_pico_scratch
  full_name: Custom Raspberry Pi Pico From Scratch
  vendor: raspberrypi
  socs:
  - name: rp2040
```

## boards/custom_pico_scratch/custom_pico_scratch_defconfig
```kconfig
CONFIG_SERIAL=y
CONFIG_CONSOLE=y
CONFIG_UART_CONSOLE=y
CONFIG_GPIO=y
CONFIG_CLOCK_CONTROL=y
CONFIG_BUILD_OUTPUT_HEX=y
CONFIG_USE_DT_CODE_PARTITION=y
```
